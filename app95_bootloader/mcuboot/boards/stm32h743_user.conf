## app95_bootloader/mcuboot/boards/stm32h743_user.conf
```kconfig
CONFIG_STM32_MEMMAP=y

# 启用 UART 控制台输出，可在串口看到 MCUboot 启动日志
CONFIG_UART_CONSOLE=y
```

## boards/arm/stm32h743_user/board.yml
```yaml
board:
  name: stm32h743_user
  full_name: STM32H743 User Board
  vendor: wj
  socs:
    - name: stm32h743xx
```
