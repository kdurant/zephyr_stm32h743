## CMakeLists.txt
```
cmake_minimum_required(VERSION 3.20.0)

list(APPEND BOARD_ROOT ${CMAKE_CURRENT_SOURCE_DIR}/..)

execute_process(
  COMMAND git -C ${CMAKE_CURRENT_SOURCE_DIR} describe --always --dirty --tags
  OUTPUT_VARIABLE APP_GIT_REV
  OUTPUT_STRIP_TRAILING_WHITESPACE
  WORKING_DIRECTORY ${CMAKE_CURRENT_SOURCE_DIR}
  ERROR_QUIET
)
execute_process(
  COMMAND git -C ${CMAKE_CURRENT_SOURCE_DIR} log -1 --format=%cs
  OUTPUT_VARIABLE APP_GIT_DATE
  OUTPUT_STRIP_TRAILING_WHITESPACE
  WORKING_DIRECTORY ${CMAKE_CURRENT_SOURCE_DIR}
  ERROR_QUIET
)

if(APP_GIT_REV AND APP_GIT_DATE)
  set(APP_VERSION "${APP_GIT_DATE}_${APP_GIT_REV}")
else()
  set(APP_VERSION "unknown")
endif()

find_package(Zephyr REQUIRED HINTS $ENV{ZEPHYR_BASE})
project(app90_ota)

target_compile_definitions(app PRIVATE APP_VERSION_STRING="${APP_VERSION}")

target_sources(app PRIVATE
    src/main.c
    src/frame.c
    src/ota_handler.c
    src/flash_ops.c
    src/log_buf.c
)
```

## prj.conf
```kconfig
CONFIG_GPIO=y
CONFIG_LOG=y
CONFIG_LOG_MODE_IMMEDIATE=y
CONFIG_LOG_DEFAULT_LEVEL=3

CONFIG_SERIAL=y
CONFIG_CONSOLE=y
CONFIG_UART_CONSOLE=y

# UART interrupt-driven API
CONFIG_UART_INTERRUPT_DRIVEN=y

# System tick
CONFIG_SYS_CLOCK_TICKS_PER_SEC=1000

# Flash support (QSPI NOR)
CONFIG_FLASH=y
CONFIG_FLASH_STM32_QSPI=y

# CRC32
CONFIG_CRC=y

# Reboot
CONFIG_REBOOT=y
```

## src/main.c
```c
#include <zephyr/kernel.h>
#include <zephyr/sys/printk.h>
#include "ota_protocol.h"
#include "ota_handler.h"

int main(void)
{
    printk("\n=== OTA Firmware Upgrade Demo ===\n");
    printk("STM32H743 OTA via MCUboot + Dual Slot\n\n");

    ota_handler_init();
    ota_protocol_init();

    printk("System ready. Waiting for OTA commands...\n\n");

    while (1) {
        ota_process_rx();
        k_msleep(10);
    }

    return 0;
}
```

## src/flash_ops.c
```c
/* SPDX-License-Identifier: Apache-2.0 */
#include "flash_ops.h"
#include "log_buf.h"
#include <zephyr/device.h>
#include <zephyr/drivers/flash.h>
#include <zephyr/sys/crc.h>
#include <zephyr/logging/log.h>
#include <string.h>

LOG_MODULE_REGISTER(flash_ops, LOG_LEVEL_INF);

/* QSPI flash sector size */
#define OTA_FLASH_SECTOR_SIZE 4096

static const struct device* flash_dev;

/* ── 内部状态 ── */
static uint32_t fw_next_offset; /* 下一次写入的偏移 */

/* ── 初始化 ── */

void flash_read_boot_config(void)
{
    flash_dev = DEVICE_DT_GET(DT_CHOSEN(zephyr_flash_controller));
    if(!device_is_ready(flash_dev))
    {
        LOG_ERR("Flash device not ready");
        return;
    }

    fw_next_offset = FIRMWARE_OFFSET;

    /* Read OTA info */
    ota_info_t info;
    int        ret = flash_read(flash_dev, FW_INFO_OFFSET, &info, sizeof(info));
    if(ret == 0 && info.magic == OTA_INFO_MAGIC)
    {
        LOG_INF("Stored OTA info: size=%u, CRC32=0x%08X, ver=%d.%d.%d",
                info.fw_size, info.fw_crc32,
                info.fw_version[0], info.fw_version[1],
                (info.fw_version[2] << 8) | info.fw_version[3]);
    }

    /* Read boot flag */
    uint8_t boot_flag;
    ret = flash_read(flash_dev, BOOT_FLAG_OFFSET, &boot_flag, 1);
    if(ret == 0)
    {
        LOG_INF("Boot flag: 0x%02X", boot_flag);
    }
}

/* ═══════════════════════════════════════════
 * Flash 操作
 * ═══════════════════════════════════════════ */

int flash_erase_firmware_region(uint32_t size)
{
    if(!flash_dev)
    {
        return -1;
    }

    /* Round up to sector boundary */
    uint32_t erase_size = ((size + OTA_FLASH_SECTOR_SIZE - 1) / OTA_FLASH_SECTOR_SIZE) * OTA_FLASH_SECTOR_SIZE;
    if(erase_size > FIRMWARE_MAX_SIZE)
    {
        erase_size = FIRMWARE_MAX_SIZE;
    }

    LOG_INF("Erasing %u bytes at offset 0x%08X...", erase_size, FIRMWARE_OFFSET);

    int ret = flash_erase(flash_dev, FIRMWARE_OFFSET, erase_size);
    if(ret < 0)
    {
        LOG_ERR("Erase failed: %d", ret);
        return ret;
    }

    fw_next_offset = FIRMWARE_OFFSET;
    LOG_INF("Erase done");
    return 0;
}

int flash_write_firmware_chunk(uint32_t offset, const uint8_t* data, uint32_t len)
{
    if(!flash_dev)
    {
        return -1;
    }

    uint32_t write_addr = FIRMWARE_OFFSET + offset;

    int ret = flash_write(flash_dev, write_addr, data, len);
    if(ret < 0)
    {
        LOG_ERR("Write failed at 0x%08X len=%u: %d", write_addr, len, ret);
        return ret;
    }

    fw_next_offset = write_addr + len;
    return 0;
}

void flash_finalize_firmware_write(void)
{
    LOG_INF("Firmware write finalized at %u bytes", fw_next_offset - FIRMWARE_OFFSET);
}

void flash_invalidate_firmware(void)
{
    /* Invalidate OTA info by clearing magic */
    ota_info_t empty = {0};
    flash_write(flash_dev, FW_INFO_OFFSET, &empty, sizeof(empty));
    fw_next_offset = FIRMWARE_OFFSET;
    LOG_INF("Firmware storage invalidated");
}

int flash_write_boot_flag(uint8_t flag)
{
    if(!flash_dev)
    {
        return -1;
    }

    /* Don't use flash_get_page_info_by_offs — it can return -EINVAL on QSPI.
     * Instead use a direct 4KB erase + write at the target offset. */

    log_buf_printf("BOOT_FLAG_OFFSET=0x%08X", BOOT_FLAG_OFFSET);

    /* Erase one sector containing BOOT_FLAG_OFFSET */
    uint32_t sector_start = BOOT_FLAG_OFFSET & ~(OTA_FLASH_SECTOR_SIZE - 1);
    int      ret          = flash_erase(flash_dev, sector_start, OTA_FLASH_SECTOR_SIZE);
    if(ret < 0)
    {
        log_buf_printf("Boot flag erase failed: %d", ret);
        return ret;
    }

    log_buf_printf("Boot flag sector erased: 0x%08X", sector_start);

    ret = flash_write(flash_dev, BOOT_FLAG_OFFSET, &flag, 1);
    if(ret < 0)
    {
        log_buf_printf("Boot flag write failed: %d", ret);
        return ret;
    }

    log_buf_printf("Boot flag set to 0x%02X", flag);
    return 0;
}

uint32_t flash_calc_firmware_crc32(uint32_t size)
{
    if(!flash_dev || size == 0)
    {
        return 0;
    }

    uint32_t crc = 0xFFFFFFFF;
    uint8_t  buf[256];
    uint32_t remaining = size;
    uint32_t offset    = FIRMWARE_OFFSET;

    while(remaining > 0)
    {
        uint32_t chunk = remaining > sizeof(buf) ? sizeof(buf) : remaining;
        int      ret   = flash_read(flash_dev, offset, buf, chunk);
        if(ret < 0)
        {
            LOG_ERR("CRC read failed at 0x%08X", offset);
            return 0;
        }

        for(uint32_t i = 0; i < chunk; i++)
        {
            crc ^= buf[i];
            for(int j = 0; j < 8; j++)
            {
                if(crc & 1)
                {
                    crc = (crc >> 1) ^ 0xEDB88320;
                }
                else
                {
                    crc >>= 1;
                }
            }
        }

        offset += chunk;
        remaining -= chunk;
    }

    return crc ^ 0xFFFFFFFF;
}
```

## src/flash_ops.h
```c
/* SPDX-License-Identifier: Apache-2.0 */
/* QSPI NOR Flash 操作封装
 *
 * 布局:
 *   [0x000000 .. FIRMWARE_MAX_SIZE]   固件存储区
 *   [FW_INFO_OFFSET]                  OTA 信息区 (固件版本/CRC/大小)
 *   [BOOT_FLAG_OFFSET]                启动标志 (1 page)
 */

#ifndef FLASH_OPS_H
#define FLASH_OPS_H

#include <stdint.h>
#include <stdbool.h>

/* ── Flash 布局常量 ── */
#define FIRMWARE_OFFSET   0x00000000
#define FIRMWARE_MAX_SIZE 0x00200000 /* 2MB — QSPI driver reports 2MB usable */
/* Place OTA metadata within the valid 2MB range */
#define FW_INFO_OFFSET   0x001FE000 /* 倒数第 2 个 4K 扇区 (2MB - 8KB) */
#define BOOT_FLAG_OFFSET 0x001FF000 /* 最后一个 4K 扇区 (2MB - 4KB) */

/* 启动标志值 */
#define BOOT_FLAG_NEW_FW   0x01
#define BOOT_FLAG_ROLLBACK 0x00
#define BOOT_FLAG_EMPTY    0xFF

/* ── OTA 信息结构 (存储在 FW_INFO_OFFSET) ── */
#pragma pack(push, 1)
typedef struct
{
    uint32_t magic; /* 0x4F544101 = "OTA\x01" */
    uint32_t fw_size;
    uint32_t fw_crc32;
    uint8_t  fw_version[4];
    uint8_t  reserved[16];
} ota_info_t;
#pragma pack(pop)

#define OTA_INFO_MAGIC 0x4F544101

/* ── API ── */
void     flash_read_boot_config(void);
int      flash_erase_firmware_region(uint32_t size);
int      flash_write_firmware_chunk(uint32_t offset, const uint8_t* data, uint32_t len);
void     flash_finalize_firmware_write(void);
void     flash_invalidate_firmware(void);
int      flash_write_boot_flag(uint8_t flag);
uint32_t flash_calc_firmware_crc32(uint32_t size);

#endif /* FLASH_OPS_H */
```

## src/frame.c
```c
/* SPDX-License-Identifier: Apache-2.0 */
#include "frame.h"
#include <string.h>

/* ── 帧解析器 ── */

void frame_decoder_init(frame_decoder_t* dec)
{
    memset(dec, 0, sizeof(*dec));
    dec->state = FRAME_STATE_HEADER0;
}

void frame_decoder_feed(frame_decoder_t* dec, uint8_t byte)
{
    /* Don't process new data until previous frame is consumed */
    if(dec->frame_ready)
    {
        return;
    }

    switch(dec->state)
    {
        case FRAME_STATE_HEADER0:
            if(byte == FRAME_HEADER0)
            {
                dec->state = FRAME_STATE_HEADER1;
            }
            /* else: stay, skip garbage */
            break;

        case FRAME_STATE_HEADER1:
            if(byte == FRAME_HEADER1)
            {
                dec->state = FRAME_STATE_FIXED;
                dec->pos   = 0;
            }
            else if(byte == FRAME_HEADER0)
            {
                /* Restart at header0 */
                dec->state = FRAME_STATE_HEADER1;
            }
            else
            {
                dec->state = FRAME_STATE_HEADER0;
            }
            break;

        case FRAME_STATE_FIXED:
            dec->fixed_buf[dec->pos++] = byte;
            if(dec->pos >= FIXED_FIELD_SIZE)
            {
                /* Parse fixed fields */
                int p          = 0;
                dec->frame.seq = dec->fixed_buf[p] | (dec->fixed_buf[p + 1] << 8);
                p += 2;
                dec->frame.src_addr = dec->fixed_buf[p] | (dec->fixed_buf[p + 1] << 8);
                p += 2;
                dec->frame.dst_addr = dec->fixed_buf[p] | (dec->fixed_buf[p + 1] << 8);
                p += 2;
                dec->frame.total_packets = dec->fixed_buf[p] | (dec->fixed_buf[p + 1] << 8);
                p += 2;
                dec->frame.packet_seq = dec->fixed_buf[p] | (dec->fixed_buf[p + 1] << 8);
                p += 2;
                dec->frame.command = dec->fixed_buf[p] | (dec->fixed_buf[p + 1] << 8);
                p += 2;
                dec->frame.data_len = dec->fixed_buf[p] | (dec->fixed_buf[p + 1] << 8);
                p += 2;

                if(dec->frame.data_len > MAX_DATA_SIZE)
                {
                    /* Invalid — reset */
                    frame_decoder_reset(dec);
                    return;
                }

                dec->expected_data_len = dec->frame.data_len;
                dec->pos               = 0;

                if(dec->expected_data_len == 0)
                {
                    dec->state = FRAME_STATE_RSV_TAIL;
                    dec->pos   = 0;
                }
                else
                {
                    dec->state = FRAME_STATE_DATA;
                }
            }
            break;

        case FRAME_STATE_DATA:
            dec->frame.data[dec->pos++] = byte;
            if(dec->pos >= dec->expected_data_len)
            {
                dec->state = FRAME_STATE_RSV_TAIL;
                dec->pos   = 0;
            }
            break;

        case FRAME_STATE_RSV_TAIL:
            dec->pos++;
            if(dec->pos == 3)
            {
                /* First tail byte */
                if(byte != FRAME_TAIL0)
                {
                    frame_decoder_reset(dec);
                    if(byte == FRAME_HEADER0)
                    {
                        dec->state = FRAME_STATE_HEADER1;
                    }
                    return;
                }
            }
            else if(dec->pos == 4)
            {
                if(byte == FRAME_TAIL1)
                {
                    dec->frame_ready = true;
                }
                /* Stay in RSV_TAIL state until consumer resets */
            }
            break;
    }
}

bool frame_decoder_ready(const frame_decoder_t* dec)
{
    return dec->frame_ready;
}

const frame_t* frame_decoder_get(const frame_decoder_t* dec)
{
    return dec->frame_ready ? &dec->frame : NULL;
}

void frame_decoder_reset(frame_decoder_t* dec)
{
    /* Preserve frame_ready if it's set — clear only after consumed */
    bool was_ready         = dec->frame_ready;
    dec->state             = FRAME_STATE_HEADER0;
    dec->pos               = 0;
    dec->expected_data_len = 0;
    if(!was_ready)
    {
        /* Keep the frame data if it was ready; only clear when explicitly reset after get */
    }
    dec->frame_ready = false;
}

/* ── 帧序列化 ── */

int frame_to_bytes(const frame_t* f, uint8_t* buf, int buf_size)
{
    int total = FRAME_OVERHEAD + f->data_len;
    if(buf_size < total)
    {
        return -1;
    }

    int pos    = 0;
    buf[pos++] = FRAME_HEADER0;
    buf[pos++] = FRAME_HEADER1;
    buf[pos++] = (uint8_t)(f->seq & 0xFF);
    buf[pos++] = (uint8_t)(f->seq >> 8);
    buf[pos++] = (uint8_t)(f->src_addr & 0xFF);
    buf[pos++] = (uint8_t)(f->src_addr >> 8);
    buf[pos++] = (uint8_t)(f->dst_addr & 0xFF);
    buf[pos++] = (uint8_t)(f->dst_addr >> 8);
    buf[pos++] = (uint8_t)(f->total_packets & 0xFF);
    buf[pos++] = (uint8_t)(f->total_packets >> 8);
    buf[pos++] = (uint8_t)(f->packet_seq & 0xFF);
    buf[pos++] = (uint8_t)(f->packet_seq >> 8);
    buf[pos++] = (uint8_t)(f->command & 0xFF);
    buf[pos++] = (uint8_t)(f->command >> 8);
    buf[pos++] = (uint8_t)(f->data_len & 0xFF);
    buf[pos++] = (uint8_t)(f->data_len >> 8);

    if(f->data_len > 0)
    {
        memcpy(&buf[pos], f->data, f->data_len);
        pos += f->data_len;
    }

    buf[pos++] = 0x00; /* rsv */
    buf[pos++] = 0x00; /* rsv */
    buf[pos++] = FRAME_TAIL0;
    buf[pos++] = FRAME_TAIL1;

    return pos;
}

/* ── 响应帧构建 ── */

void frame_build_error_resp(const frame_t* req, frame_t* resp)
{
    memset(resp, 0, sizeof(*resp));
    resp->seq           = req->seq;
    resp->src_addr      = ADDR_DEVICE;
    resp->dst_addr      = req->src_addr;
    resp->command       = req->command;
    resp->total_packets = 1;
    resp->packet_seq    = 0;
    resp->data_len      = 4;
    memset(resp->data, ERROR_MARKER_BYTE, 4);
}

void frame_build_resp(const frame_t* req, frame_t* resp,
                      const uint8_t* data, uint16_t data_len)
{
    memset(resp, 0, sizeof(*resp));
    resp->seq           = req->seq;
    resp->src_addr      = ADDR_DEVICE;
    resp->dst_addr      = req->src_addr;
    resp->command       = req->command;
    resp->total_packets = 1;
    resp->packet_seq    = 0;
    resp->data_len      = data_len;
    if(data_len > 0 && data_len <= MAX_DATA_SIZE)
    {
        memcpy(resp->data, data, data_len);
    }
}
```

## src/frame.h
```c
/* SPDX-License-Identifier: Apache-2.0 */
/* OTA 协议帧格式定义 (与上位机协议一致) */

#ifndef FRAME_H
#define FRAME_H

#include <stdint.h>
#include <stdbool.h>
#include <stddef.h>

/* ── 帧常量 ── */
#define FRAME_HEADER0 0x12
#define FRAME_HEADER1 0x34
#define FRAME_TAIL0   0xCD
#define FRAME_TAIL1   0xEF

#define HEADER_SIZE      2
#define FIXED_FIELD_SIZE 14                               /* seq+src+dst+total+pkt_seq+cmd+len = 14 */
#define PREFIX_SIZE      (HEADER_SIZE + FIXED_FIELD_SIZE) /* 16 */
#define SUFFIX_SIZE      4                                /* rsv(2) + tail(2) */
#define FRAME_OVERHEAD   (PREFIX_SIZE + SUFFIX_SIZE)      /* 20 */
#define MAX_DATA_SIZE    4096
#define MAX_FRAME_SIZE   (FRAME_OVERHEAD + MAX_DATA_SIZE)
#define MIN_FRAME_SIZE   FRAME_OVERHEAD

/* ── 地址常量 ── */
#define ADDR_PC     0x0000
#define ADDR_DEVICE 0x0020
#define ADDR_DAQ    0x0010

/* ── 指令码 ── */
#define CMD_HANDSHAKE         0x0001
#define CMD_GET_DEVICE_INFO   0x0002
#define CMD_START_UPGRADE     0x0003
#define CMD_TRANSFER_DATA     0x0004
#define CMD_TRANSFER_COMPLETE 0x0005
#define CMD_VERIFY_FIRMWARE   0x0006
#define CMD_RESET_RUN         0x0007
#define CMD_CANCEL_UPGRADE    0x0008
#define CMD_QUERY_STATUS      0x0009
#define CMD_SET_BOOT_FLAG     0x000A
#define CMD_GET_LOG           0x000B

/* ── 错误标记 ── */
#define ERROR_MARKER_BYTE 0xFF

/* ── 帧结构体 ── */
typedef struct
{
    uint16_t seq;
    uint16_t src_addr;
    uint16_t dst_addr;
    uint16_t total_packets;
    uint16_t packet_seq;
    uint16_t command;
    uint16_t data_len;
    uint8_t  data[MAX_DATA_SIZE];
} frame_t;

/* ── 帧解析器状态机 ── */
typedef enum
{
    FRAME_STATE_HEADER0,
    FRAME_STATE_HEADER1,
    FRAME_STATE_FIXED,
    FRAME_STATE_DATA,
    FRAME_STATE_RSV_TAIL,
} frame_state_t;

typedef struct
{
    frame_state_t state;
    uint16_t      pos;
    uint8_t       fixed_buf[FIXED_FIELD_SIZE];
    uint16_t      expected_data_len;
    frame_t       frame;
    bool          frame_ready;
} frame_decoder_t;

/* ── API ── */
void           frame_decoder_init(frame_decoder_t* dec);
void           frame_decoder_feed(frame_decoder_t* dec, uint8_t byte);
bool           frame_decoder_ready(const frame_decoder_t* dec);
const frame_t* frame_decoder_get(const frame_decoder_t* dec);
void           frame_decoder_reset(frame_decoder_t* dec);

/* 将 frame 序列化为字节流，返回实际长度 */
int frame_to_bytes(const frame_t* f, uint8_t* buf, int buf_size);

/* 构建响应帧（数据区填充 4 字节 0xFF 表示错误） */
void frame_build_error_resp(const frame_t* req, frame_t* resp);
void frame_build_resp(const frame_t* req, frame_t* resp,
                      const uint8_t* data, uint16_t data_len);

#endif /* FRAME_H */
```

## src/log_buf.c
```c
/* SPDX-License-Identifier: Apache-2.0 */
#include "log_buf.h"
#include <stdarg.h>
#include <stdio.h>
#include <string.h>
#include <zephyr/sys/printk.h>

/* 环形缓冲区数据 */
static char g_lines[LOG_BUF_LINES][LOG_LINE_MAX];
static int  g_write_idx; /* 当前写入行索引 (0..LOG_BUF_LINES-1) */
static int  g_read_idx;  /* 当前读取行索引 (≤ write_idx)  */
static bool g_wrapped;   /* 是否绕过一圈 */

void log_buf_init(void)
{
    memset(g_lines, 0, sizeof(g_lines));
    g_write_idx = 0;
    g_read_idx  = 0;
    g_wrapped   = false;
}

void log_buf_printf(const char* fmt, ...)
{
    va_list args;

    /* 格式化到当前行 */
    va_start(args, fmt);
    vsnprintf(g_lines[g_write_idx], LOG_LINE_MAX, fmt, args);
    va_end(args);

    /* 推进写指针 */
    g_write_idx = (g_write_idx + 1) % LOG_BUF_LINES;

    /* 如果写指针追上读指针，读指针同步前移（丢弃最旧内容） */
    if(g_write_idx == g_read_idx && g_wrapped)
    {
        g_read_idx = (g_read_idx + 1) % LOG_BUF_LINES;
    }

    if(g_write_idx == 0)
    {
        g_wrapped = true;
    }

    /* 同时输出到串口控制台（仅作 fallback，上位机可通过 CMD_GET_LOG 获取） */
    printk("[OTA] %s\n", g_lines[(g_write_idx + LOG_BUF_LINES - 1) % LOG_BUF_LINES]);
}

int log_buf_read(char* buf, int buf_size)
{
    if(!g_wrapped && g_read_idx == g_write_idx)
    {
        return 0; /* 无新日志 */
    }

    int pos = 0;
    while(pos < buf_size - 1)
    {
        if(!g_wrapped && g_read_idx == g_write_idx)
        {
            break;
        }

        int len       = (int)strnlen(g_lines[g_read_idx], LOG_LINE_MAX);
        int remaining = buf_size - pos - 1;

        if(len > 0)
        {
            int copy_len = (len < remaining) ? len : remaining;
            memcpy(&buf[pos], g_lines[g_read_idx], copy_len);
            pos += copy_len;
            /* 追加换行 */
            if(pos < buf_size - 1)
            {
                buf[pos++] = '\n';
            }
        }

        g_read_idx = (g_read_idx + 1) % LOG_BUF_LINES;
        if(g_read_idx == 0)
        {
            g_wrapped = false;
        }
    }

    buf[pos] = '\0';
    return pos;
}

void log_buf_mark_read(void)
{
    if(g_wrapped)
    {
        g_read_idx = g_write_idx;
        g_wrapped  = false;
    }
}

bool log_buf_has_unread(void)
{
    if(g_wrapped)
        return true;
    return g_read_idx != g_write_idx;
}
```

## src/log_buf.h
```c
/* SPDX-License-Identifier: Apache-2.0 */
/* 环形日志缓冲区 — 供 OTA 协议传输到上位机 */

#ifndef LOG_BUF_H
#define LOG_BUF_H

#include <stdint.h>
#include <stddef.h>
#include <stdbool.h>

/* 缓冲区可容纳 48 行，每行最多 120 字符 */
#define LOG_BUF_LINES 48
#define LOG_LINE_MAX  120

void log_buf_init(void);
void log_buf_printf(const char* fmt, ...);

/* 读取所有未读日志，返回写入字节数 (不含末尾 null)，读完后标记为已读 */
int log_buf_read(char* buf, int buf_size);

/* 强制标记为已读（丢弃未读内容） */
void log_buf_mark_read(void);

/* 判断是否有未读日志 */
bool log_buf_has_unread(void);

#endif /* LOG_BUF_H */
```

## src/ota_handler.c
```c
#include "ota_handler.h"
#include "ota_protocol.h"
#include <zephyr/kernel.h>
#include <zephyr/device.h>
#include <zephyr/drivers/flash.h>
#include <zephyr/storage/flash_map.h>
#include <zephyr/sys/crc.h>
#include <zephyr/sys/reboot.h>
#include <string.h>

static const struct flash_area *slot0_area;
static const struct flash_area *slot1_area;

ota_state_t ota_state;

#define PROTOCOL_VERSION_MAJOR  1
#define PROTOCOL_VERSION_MINOR  0

#define MCU_MODEL "STM32H743"

void ota_handler_init(void)
{
    int err = flash_area_open(PARTITION_ID(slot0_partition), &slot0_area);
    if (err) {
        printk("Failed to open slot0 area: %d\n", err);
        return;
    }

    err = flash_area_open(PARTITION_ID(slot1_partition), &slot1_area);
    if (err) {
        printk("Failed to open slot1 area: %d\n", err);
        return;
    }

    ota_state.status = STATUS_IDLE;
    ota_state.error_code = ERR_NONE;
    ota_state.received_size = 0;
    ota_state.firmware_size = 0;
    ota_state.firmware_crc = 0;
    ota_state.calculated_crc = 0;
    ota_state.current_offset = 0;
    ota_state.max_packet_size = MAX_PACKET_SIZE;
    ota_state.in_progress = false;

    if (slot0_area && slot1_area) {
        ota_state.slot0_offset = slot0_area->fa_off;
        ota_state.slot1_offset = slot1_area->fa_off;
        ota_state.slot_size = slot0_area->fa_size;
    } else {
        ota_state.slot0_offset = 0x20000;
        ota_state.slot1_offset = 0x110000;
        ota_state.slot_size = 0xF0000;
    }

    printk("OTA handler initialized, slot0=0x%x, slot1=0x%x, size=%d\n",
           ota_state.slot0_offset, ota_state.slot1_offset, ota_state.slot_size);
}

void ota_cmd_handshake(uint16_t seq, const uint8_t *data, uint16_t len)
{
    uint8_t resp[3];
    resp[0] = ota_state.status;
    resp[1] = PROTOCOL_VERSION_MINOR;
    resp[2] = PROTOCOL_VERSION_MAJOR;

    ota_send_response(seq, CMD_HANDSHAKE, resp, sizeof(resp));
    printk("Handshake: status=%d\n", ota_state.status);
}

void ota_cmd_get_dev_info(uint16_t seq, const uint8_t *data, uint16_t len)
{
    uint8_t resp[34];
    memset(resp, 0, sizeof(resp));

    strncpy((char *)resp, MCU_MODEL, 16);

    uint32_t version = 0x01000000;
    memcpy(&resp[16], &version, 4);

    uint32_t flash_size = 2 * 1024 * 1024;
    memcpy(&resp[20], &flash_size, 4);

    uint16_t page_size = 4096;
    memcpy(&resp[24], &page_size, 2);

    uint32_t used_size = 0x20000;
    memcpy(&resp[26], &used_size, 4);

    uint32_t fw_start = ota_state.slot0_offset;
    memcpy(&resp[30], &fw_start, 4);

    ota_send_response(seq, CMD_GET_DEV_INFO, resp, sizeof(resp));
    printk("Get device info\n");
}

void ota_cmd_start_upgrade(uint16_t seq, const uint8_t *data, uint16_t len)
{
    if (len < 12) {
        uint8_t fail[4] = { 0xFF, 0xFF, 0xFF, 0xFF };
        ota_send_response(seq, CMD_START_UPGRADE, fail, 4);
        return;
    }

    if (ota_state.status != STATUS_IDLE && ota_state.status != STATUS_COMPLETE) {
        uint8_t resp[4];
        resp[0] = 0xFF;
        memset(&resp[1], 0xFF, 3);
        ota_send_response(seq, CMD_START_UPGRADE, resp, 4);
        printk("Start upgrade rejected: busy\n");
        return;
    }

    memcpy(&ota_state.firmware_size, &data[0], 4);
    memcpy(&ota_state.firmware_crc, &data[4], 4);

    if (ota_state.firmware_size > ota_state.slot_size) {
        ota_state.error_code = ERR_FIRMWARE_SIZE;
        uint8_t resp[4] = { 0xFF, 0xFF, 0xFF, 0xFF };
        ota_send_response(seq, CMD_START_UPGRADE, resp, 4);
        printk("Firmware size exceeds slot: %d > %d\n",
               ota_state.firmware_size, ota_state.slot_size);
        return;
    }

    ota_state.status = STATUS_ERASING;
    ota_state.received_size = 0;
    ota_state.current_offset = 0;
    ota_state.in_progress = true;
    ota_state.calculated_crc = 0;

    printk("Start upgrade: size=%d, crc=0x%08x\n",
           ota_state.firmware_size, ota_state.firmware_crc);

    int err = flash_area_erase(slot1_area, 0, ota_state.slot_size);
    if (err) {
        ota_state.status = STATUS_IDLE;
        ota_state.error_code = ERR_FLASH_ERASE;
        ota_state.in_progress = false;
        uint8_t resp[4] = { 0xFF, 0xFF, 0xFF, 0xFF };
        ota_send_response(seq, CMD_START_UPGRADE, resp, 4);
        printk("Flash erase failed: %d\n", err);
        return;
    }

    ota_state.status = STATUS_RECEIVING;

    uint8_t resp[4];
    resp[0] = 0x00;
    uint16_t max_pkt = MAX_PACKET_SIZE;
    memcpy(&resp[1], &max_pkt, 2);
    resp[3] = 100;

    ota_send_response(seq, CMD_START_UPGRADE, resp, sizeof(resp));
    printk("Upgrade ready, max packet=%d\n", max_pkt);
}

void ota_cmd_transfer_data(uint16_t seq, const uint8_t *data, uint16_t len)
{
    if (!ota_state.in_progress || ota_state.status != STATUS_RECEIVING) {
        uint8_t fail[5] = { 0xFF, 0xFF, 0xFF, 0xFF, 0xFF };
        ota_send_response(seq, CMD_TRANSFER_DATA, fail, 5);
        return;
    }

    if (len < 4) {
        uint8_t fail[5] = { 0xFF, 0xFF, 0xFF, 0xFF, 0xFF };
        ota_send_response(seq, CMD_TRANSFER_DATA, fail, 5);
        return;
    }

    uint32_t offset;
    memcpy(&offset, &data[0], 4);

    const uint8_t *fw_data = &data[4];
    uint16_t fw_len = len - 4;

    if (offset != ota_state.current_offset) {
        ota_state.error_code = ERR_OFFSET_ERROR;
        ota_state.status = STATUS_ERROR;
        uint8_t resp[5] = { 0x01, 0xFF, 0xFF, 0xFF, 0xFF };
        ota_send_response(seq, CMD_TRANSFER_DATA, resp, 5);
        printk("Offset error: expected %d, got %d\n",
               ota_state.current_offset, offset);
        return;
    }

    if (offset + fw_len > ota_state.firmware_size) {
        ota_state.error_code = ERR_FIRMWARE_SIZE;
        ota_state.status = STATUS_ERROR;
        uint8_t resp[5] = { 0xFF, 0xFF, 0xFF, 0xFF, 0xFF };
        ota_send_response(seq, CMD_TRANSFER_DATA, resp, 5);
        printk("Data exceeds firmware size\n");
        return;
    }

    int err = flash_area_write(slot1_area, offset, fw_data, fw_len);
    if (err) {
        ota_state.error_code = ERR_FLASH_WRITE;
        ota_state.status = STATUS_ERROR;
        uint8_t resp[5] = { 0xFF, 0xFF, 0xFF, 0xFF, 0xFF };
        ota_send_response(seq, CMD_TRANSFER_DATA, resp, 5);
        printk("Flash write failed: %d\n", err);
        return;
    }

    ota_state.calculated_crc = crc32_ieee_update(ota_state.calculated_crc,
                                                  fw_data, fw_len);
    ota_state.current_offset += fw_len;
    ota_state.received_size += fw_len;

    uint8_t resp[5];
    resp[0] = 0x00;
    memcpy(&resp[1], &ota_state.received_size, 4);

    ota_send_response(seq, CMD_TRANSFER_DATA, resp, sizeof(resp));
}

void ota_cmd_transfer_done(uint16_t seq, const uint8_t *data, uint16_t len)
{
    if (!ota_state.in_progress) {
        uint8_t fail[5] = { 0xFF, 0xFF, 0xFF, 0xFF, 0xFF };
        ota_send_response(seq, CMD_TRANSFER_DONE, fail, 5);
        return;
    }

    uint32_t declared_crc, declared_size;
    memcpy(&declared_crc, &data[0], 4);
    memcpy(&declared_size, &data[4], 4);

    if (declared_size != ota_state.received_size) {
        ota_state.error_code = ERR_FIRMWARE_SIZE;
        ota_state.status = STATUS_ERROR;
        uint8_t resp[5] = { 0xFF, 0xFF, 0xFF, 0xFF, 0xFF };
        ota_send_response(seq, CMD_TRANSFER_DONE, resp, 5);
        printk("Size mismatch: declared=%d, received=%d\n",
               declared_size, ota_state.received_size);
        return;
    }

    ota_state.firmware_size = declared_size;
    ota_state.firmware_crc = declared_crc;
    ota_state.status = STATUS_COMPLETE;

    uint8_t resp[5];
    resp[0] = 0x00;
    memcpy(&resp[1], &ota_state.received_size, 4);

    ota_send_response(seq, CMD_TRANSFER_DONE, resp, sizeof(resp));
    printk("Transfer done: size=%d, crc=0x%08x\n",
           ota_state.received_size, ota_state.calculated_crc);
}

void ota_cmd_verify_firmware(uint16_t seq, const uint8_t *data, uint16_t len)
{
    if (ota_state.status != STATUS_COMPLETE) {
        uint8_t fail[5] = { 0xFF, 0xFF, 0xFF, 0xFF, 0xFF };
        ota_send_response(seq, CMD_VERIFY_FIRMWARE, fail, 5);
        return;
    }

    ota_state.status = STATUS_VERIFYING;

    uint32_t crc = crc32_ieee(NULL, 0);

    uint8_t buf[256];
    uint32_t remaining = ota_state.firmware_size;
    uint32_t offset = 0;

    while (remaining > 0) {
        uint32_t chunk = remaining > sizeof(buf) ? sizeof(buf) : remaining;
        int err = flash_area_read(slot1_area, offset, buf, chunk);
        if (err) {
            ota_state.status = STATUS_ERROR;
            ota_state.error_code = ERR_FLASH_WRITE;
            uint8_t fail[5] = { 0xFF, 0xFF, 0xFF, 0xFF, 0xFF };
            ota_send_response(seq, CMD_VERIFY_FIRMWARE, fail, 5);
            printk("Verify read failed: %d\n", err);
            return;
        }
        crc = crc32_ieee_update(crc, buf, chunk);
        offset += chunk;
        remaining -= chunk;
    }

    ota_state.calculated_crc = crc;

    uint8_t resp[5];
    if (crc == ota_state.firmware_crc) {
        resp[0] = 0x00;
        printk("CRC verify OK: 0x%08x\n", crc);
    } else {
        resp[0] = 0x01;
        ota_state.error_code = ERR_CRC_MISMATCH;
        printk("CRC mismatch: expected 0x%08x, got 0x%08x\n",
               ota_state.firmware_crc, crc);
    }
    memcpy(&resp[1], &ota_state.calculated_crc, 4);

    ota_send_response(seq, CMD_VERIFY_FIRMWARE, resp, sizeof(resp));
}

void ota_cmd_reset_run(uint16_t seq, const uint8_t *data, uint16_t len)
{
    if (ota_state.status != STATUS_COMPLETE) {
        uint8_t fail[1] = { 0xFF };
        ota_send_response(seq, CMD_RESET_RUN, fail, 1);
        return;
    }

    uint16_t delay_ms = 0;
    if (len >= 2) {
        memcpy(&delay_ms, &data[0], 2);
    }

    uint8_t resp[1] = { 0x00 };
    ota_send_response(seq, CMD_RESET_RUN, resp, 1);

    printk("Reset in %d ms\n", delay_ms);
    k_msleep(delay_ms);

    sys_reboot(SYS_REBOOT_COLD);
}

void ota_cmd_cancel_upgrade(uint16_t seq, const uint8_t *data, uint16_t len)
{
    ota_state.status = STATUS_IDLE;
    ota_state.error_code = ERR_NONE;
    ota_state.received_size = 0;
    ota_state.current_offset = 0;
    ota_state.in_progress = false;
    ota_state.calculated_crc = 0;

    uint8_t resp[1] = { 0x00 };
    ota_send_response(seq, CMD_CANCEL_UPGRADE, resp, 1);
    printk("Upgrade cancelled\n");
}

void ota_cmd_query_status(uint16_t seq, const uint8_t *data, uint16_t len)
{
    uint8_t resp[14];
    memset(resp, 0, sizeof(resp));

    resp[0] = ota_state.status;
    memcpy(&resp[1], &ota_state.received_size, 4);
    memcpy(&resp[5], &ota_state.firmware_size, 4);
    resp[9] = ota_state.error_code;

    ota_send_response(seq, CMD_QUERY_STATUS, resp, sizeof(resp));
}

void ota_cmd_set_boot_flag(uint16_t seq, const uint8_t *data, uint16_t len)
{
    if (len < 1) {
        uint8_t fail[1] = { 0xFF };
        ota_send_response(seq, CMD_SET_BOOT_FLAG, fail, 1);
        return;
    }

    uint8_t flag = data[0];

    if (flag == 0x01 && ota_state.status == STATUS_COMPLETE) {
        ota_state.boot_flag = 1;
        uint8_t resp[1] = { 0x00 };
        ota_send_response(seq, CMD_SET_BOOT_FLAG, resp, 1);
        printk("Boot flag set to new firmware\n");
    } else if (flag == 0x00) {
        ota_state.boot_flag = 0;
        uint8_t resp[1] = { 0x00 };
        ota_send_response(seq, CMD_SET_BOOT_FLAG, resp, 1);
        printk("Boot flag cleared\n");
    } else {
        uint8_t resp[1] = { 0xFF };
        ota_send_response(seq, CMD_SET_BOOT_FLAG, resp, 1);
        printk("Set boot flag failed\n");
    }
}
```

## src/ota_handler.h
```c
#ifndef OTA_HANDLER_H
#define OTA_HANDLER_H

#include <stdint.h>
#include <stdbool.h>

typedef struct {
    uint8_t  status;
    uint8_t  error_code;
    uint32_t received_size;
    uint32_t firmware_size;
    uint32_t firmware_crc;
    uint32_t calculated_crc;
    uint32_t current_offset;
    uint16_t max_packet_size;
    uint8_t  boot_flag;
    uint32_t slot0_offset;
    uint32_t slot1_offset;
    uint32_t slot_size;
    bool     in_progress;
} ota_state_t;

extern ota_state_t ota_state;

void ota_handler_init(void);

void ota_cmd_handshake(uint16_t seq, const uint8_t *data, uint16_t len);
void ota_cmd_get_dev_info(uint16_t seq, const uint8_t *data, uint16_t len);
void ota_cmd_start_upgrade(uint16_t seq, const uint8_t *data, uint16_t len);
void ota_cmd_transfer_data(uint16_t seq, const uint8_t *data, uint16_t len);
void ota_cmd_transfer_done(uint16_t seq, const uint8_t *data, uint16_t len);
void ota_cmd_verify_firmware(uint16_t seq, const uint8_t *data, uint16_t len);
void ota_cmd_reset_run(uint16_t seq, const uint8_t *data, uint16_t len);
void ota_cmd_cancel_upgrade(uint16_t seq, const uint8_t *data, uint16_t len);
void ota_cmd_query_status(uint16_t seq, const uint8_t *data, uint16_t len);
void ota_cmd_set_boot_flag(uint16_t seq, const uint8_t *data, uint16_t len);

#endif
```

## src/ota_protocol.c
```c
#include "ota_protocol.h"
#include "ota_handler.h"
#include <zephyr/kernel.h>
#include <zephyr/device.h>
#include <zephyr/drivers/uart.h>
#include <string.h>

#define UART_NODE DT_CHOSEN(zephyr_console)
static const struct device *const uart_dev = DEVICE_DT_GET(UART_NODE);

#define RX_BUF_SIZE 4096
static uint8_t rx_buf[RX_BUF_SIZE];
static volatile uint16_t rx_len;

static ota_cmd_entry_t cmd_table[] = {
    { CMD_HANDSHAKE,       ota_cmd_handshake },
    { CMD_GET_DEV_INFO,    ota_cmd_get_dev_info },
    { CMD_START_UPGRADE,   ota_cmd_start_upgrade },
    { CMD_TRANSFER_DATA,   ota_cmd_transfer_data },
    { CMD_TRANSFER_DONE,   ota_cmd_transfer_done },
    { CMD_VERIFY_FIRMWARE, ota_cmd_verify_firmware },
    { CMD_RESET_RUN,       ota_cmd_reset_run },
    { CMD_CANCEL_UPGRADE,  ota_cmd_cancel_upgrade },
    { CMD_QUERY_STATUS,    ota_cmd_query_status },
    { CMD_SET_BOOT_FLAG,   ota_cmd_set_boot_flag },
};

static void uart_cb(const struct device *dev, struct uart_event *evt,
                    void *user_data)
{
    switch (evt->type) {
    case UART_RX_RDY:
        {
            uint16_t copy_len = evt->data.rx.len;
            if (rx_len + copy_len <= RX_BUF_SIZE) {
                memcpy(&rx_buf[rx_len],
                       &evt->data.rx.buf[evt->data.rx.offset],
                       copy_len);
                rx_len += copy_len;
            }
        }
        break;
    case UART_RX_BUF_REQUEST:
        {
            int err = uart_rx_buf_rsp(dev, rx_buf + rx_len,
                                       RX_BUF_SIZE - rx_len);
            if (err) {
                printk("uart_rx_buf_rsp err %d\n", err);
            }
        }
        break;
    case UART_RX_BUF_RELEASED:
    case UART_RX_DISABLED:
    case UART_TX_DONE:
    case UART_TX_ABORTED:
        break;
    default:
        break;
    }
}

void ota_protocol_init(void)
{
    int err;

    if (!device_is_ready(uart_dev)) {
        printk("UART not ready\n");
        return;
    }

    err = uart_callback_set(uart_dev, uart_cb, NULL);
    if (err) {
        printk("uart_callback_set failed: %d\n", err);
        return;
    }

    rx_len = 0;
    err = uart_rx_enable(uart_dev, rx_buf, RX_BUF_SIZE, 100000);
    if (err) {
        printk("uart_rx_enable failed: %d\n", err);
        return;
    }

    printk("OTA protocol initialized\n");
}

static uint16_t find_frame_start(const uint8_t *buf, uint16_t len, uint16_t offset)
{
    for (uint16_t i = offset; i < len - 1; i++) {
        if (buf[i] == FRAME_HEADER_0 && buf[i + 1] == FRAME_HEADER_1) {
            return i;
        }
    }
    return len;
}

int ota_frame_parse(const uint8_t *buf, uint16_t len, ota_frame_t *frame)
{
    if (len < FRAME_MIN_SIZE) {
        return -1;
    }

    uint16_t pos = 0;
    while (pos <= len - FRAME_MIN_SIZE) {
        if (buf[pos] == FRAME_HEADER_0 && buf[pos + 1] == FRAME_HEADER_1) {
            break;
        }
        pos++;
    }

    if (pos > len - FRAME_MIN_SIZE) {
        return -1;
    }

    const ota_frame_header_t *hdr = (const ota_frame_header_t *)&buf[pos];
    uint16_t data_len = hdr->data_len;

    uint16_t total_frame_len = sizeof(ota_frame_header_t) + data_len + sizeof(ota_frame_tail_t);
    if (pos + total_frame_len > len) {
        return -1;
    }

    memcpy(frame->header, hdr->header, 2);
    frame->seq = hdr->seq;
    frame->src_addr = hdr->src_addr;
    frame->dst_addr = hdr->dst_addr;
    frame->total_packets = hdr->total_packets;
    frame->packet_seq = hdr->packet_seq;
    frame->cmd = hdr->cmd;
    frame->data_len = data_len;

    if (data_len > 0) {
        memcpy(frame->data, &buf[pos + sizeof(ota_frame_header_t)], data_len);
    }

    const ota_frame_tail_t *tail =
        (const ota_frame_tail_t *)&buf[pos + sizeof(ota_frame_header_t) + data_len];
    frame->reserved = tail->reserved;
    frame->tail[0] = tail->tail[0];
    frame->tail[1] = tail->tail[1];

    return total_frame_len;
}

int ota_frame_build(ota_frame_t *frame, uint16_t seq, uint16_t src, uint16_t dst,
                    uint16_t total, uint16_t pkt_seq, uint16_t cmd,
                    const uint8_t *data, uint16_t data_len)
{
    frame->header[0] = FRAME_HEADER_0;
    frame->header[1] = FRAME_HEADER_1;
    frame->seq = seq;
    frame->src_addr = src;
    frame->dst_addr = dst;
    frame->total_packets = total;
    frame->packet_seq = pkt_seq;
    frame->cmd = cmd;
    frame->data_len = data_len;

    if (data && data_len > 0) {
        memcpy(frame->data, data, data_len);
    }

    frame->reserved = 0;
    frame->tail[0] = FRAME_TAIL_0;
    frame->tail[1] = FRAME_TAIL_1;

    return sizeof(ota_frame_header_t) + data_len + sizeof(ota_frame_tail_t);
}

void ota_send_response(uint16_t seq, uint16_t cmd, const uint8_t *data, uint16_t len)
{
    ota_frame_t resp;
    uint16_t frame_len = ota_frame_build(&resp, seq, ADDR_DEVICE, ADDR_PC,
                                         1, 0, cmd, data, len);
    uart_tx(uart_dev, (uint8_t *)&resp, frame_len, SYS_FOREVER_US);
}

void ota_frame_process(const ota_frame_t *frame)
{
    if (frame->dst_addr != ADDR_DEVICE && frame->dst_addr != 0xFF) {
        return;
    }

    for (int i = 0; i < ARRAY_SIZE(cmd_table); i++) {
        if (cmd_table[i].cmd == frame->cmd) {
            cmd_table[i].handler(frame->seq, frame->data, frame->data_len);
            return;
        }
    }

    uint8_t fail_resp[4] = { 0xFF, 0xFF, 0xFF, 0xFF };
    ota_send_response(frame->seq, frame->cmd, fail_resp, 4);
}

void ota_process_rx(void)
{
    uint16_t processed = 0;

    while (processed < rx_len) {
        ota_frame_t frame;
        int frame_len = ota_frame_parse(&rx_buf[processed], rx_len - processed, &frame);

        if (frame_len <= 0) {
            break;
        }

        ota_frame_process(&frame);
        processed += frame_len;
    }

    if (processed > 0 && processed < rx_len) {
        memmove(rx_buf, &rx_buf[processed], rx_len - processed);
        rx_len -= processed;
    } else if (processed >= rx_len) {
        rx_len = 0;
    }
}
```

## src/ota_protocol.h
```c
#ifndef OTA_PROTOCOL_H
#define OTA_PROTOCOL_H

#include <stdint.h>
#include <stdbool.h>
#include <zephyr/kernel.h>

#define FRAME_HEADER_0      0x12
#define FRAME_HEADER_1      0x34
#define FRAME_TAIL_0        0xCD
#define FRAME_TAIL_1        0xEF

#define FRAME_MIN_SIZE      18
#define FRAME_MAX_DATA_LEN  65535

#define ADDR_PC             0x00
#define ADDR_COLLECT        0x10
#define ADDR_DEVICE         0x20

#define CMD_HANDSHAKE       0x0001
#define CMD_GET_DEV_INFO    0x0002
#define CMD_START_UPGRADE   0x0003
#define CMD_TRANSFER_DATA   0x0004
#define CMD_TRANSFER_DONE   0x0005
#define CMD_VERIFY_FIRMWARE 0x0006
#define CMD_RESET_RUN       0x0007
#define CMD_CANCEL_UPGRADE  0x0008
#define CMD_QUERY_STATUS    0x0009
#define CMD_SET_BOOT_FLAG   0x000A

#define STATUS_IDLE         0x00
#define STATUS_ERASING      0x01
#define STATUS_RECEIVING    0x02
#define STATUS_VERIFYING    0x03
#define STATUS_COMPLETE     0x04
#define STATUS_ERROR        0xFF

#define ERR_NONE            0x00
#define ERR_FIRMWARE_SIZE   0x01
#define ERR_FLASH_ERASE     0x02
#define ERR_FLASH_WRITE     0x03
#define ERR_CRC_MISMATCH    0x04
#define ERR_OFFSET_ERROR    0x05
#define ERR_TIMEOUT         0x06
#define ERR_VERSION_LOW     0x07
#define ERR_UNKNOWN         0xFF

#define MAX_PACKET_SIZE     1024

#pragma pack(push, 1)
typedef struct {
    uint8_t  header[2];
    uint16_t seq;
    uint16_t src_addr;
    uint16_t dst_addr;
    uint16_t total_packets;
    uint16_t packet_seq;
    uint16_t cmd;
    uint16_t data_len;
    uint8_t  data[FRAME_MAX_DATA_LEN];
    uint16_t reserved;
    uint8_t  tail[2];
} ota_frame_t;
#pragma pack(pop)

#pragma pack(push, 1)
typedef struct {
    uint8_t  header[2];
    uint16_t seq;
    uint16_t src_addr;
    uint16_t dst_addr;
    uint16_t total_packets;
    uint16_t packet_seq;
    uint16_t cmd;
    uint16_t data_len;
} ota_frame_header_t;
#pragma pack(pop)

#pragma pack(push, 1)
typedef struct {
    uint16_t reserved;
    uint8_t  tail[2];
} ota_frame_tail_t;
#pragma pack(pop)

typedef void (*ota_cmd_handler_t)(uint16_t seq, const uint8_t *data, uint16_t len);

typedef struct {
    uint16_t cmd;
    ota_cmd_handler_t handler;
} ota_cmd_entry_t;

void ota_protocol_init(void);
int ota_frame_parse(const uint8_t *buf, uint16_t len, ota_frame_t *frame);
int ota_frame_build(ota_frame_t *frame, uint16_t seq, uint16_t src, uint16_t dst,
                    uint16_t total, uint16_t pkt_seq, uint16_t cmd,
                    const uint8_t *data, uint16_t data_len);
void ota_frame_process(const ota_frame_t *frame);
void ota_send_response(uint16_t seq, uint16_t cmd, const uint8_t *data, uint16_t len);
void ota_process_rx(void);

#endif
```
