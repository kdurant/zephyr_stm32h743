## CMakeLists.txt
```
cmake_minimum_required(VERSION 3.20.0)

# Allow building custom out-of-tree boards stored in ../boards.
list(APPEND BOARD_ROOT ${CMAKE_CURRENT_SOURCE_DIR}/..)

find_package(Zephyr REQUIRED HINTS $ENV{ZEPHYR_BASE})
project(app70_ethernet)

target_sources(app PRIVATE src/main.c)
```

## prj.conf
```kconfig
CONFIG_REQUIRES_FULL_LIBC=y

# 网络协议栈
CONFIG_NETWORKING=y
CONFIG_NET_SOCKETS=y
CONFIG_POSIX_API=y

CONFIG_NET_IPV4=y
CONFIG_NET_TCP=y

# STM32 以太网驱动
CONFIG_ETH_DRIVER=y
CONFIG_NET_DRIVERS=y
CONFIG_ETH_STM32_HAL=y

# 随机数熵源 (TCP 协议栈需要)
CONFIG_ENTROPY_GENERATOR=y
CONFIG_ENTROPY_STM32_RNG=y

# 以太网 L2 层
CONFIG_NET_L2_ETHERNET=y

# 静态 IP 配置 (根据你的局域网修改)
CONFIG_NET_CONFIG_SETTINGS=y
CONFIG_NET_CONFIG_MY_IPV4_ADDR="192.168.1.100"
CONFIG_NET_CONFIG_MY_IPV4_NETMASK="255.255.255.0"
CONFIG_NET_CONFIG_MY_IPV4_GW="192.168.1.1"

# 堆内存
CONFIG_HEAP_MEM_POOL_SIZE=16384
CONFIG_MAIN_STACK_SIZE=4096

# 日志
CONFIG_LOG=y
CONFIG_LOG_MODE_IMMEDIATE=y
CONFIG_LOG_DEFAULT_LEVEL=3
CONFIG_UART_CONSOLE=y

# 串口
CONFIG_SERIAL=y
CONFIG_UART_STM32=y
CONFIG_UART_INTERRUPT_DRIVEN=y

# 控制台 (TCP server 需要键盘输入)
CONFIG_CONSOLE_SUBSYS=y
CONFIG_CONSOLE_GETCHAR=y
CONFIG_CONSOLE_GETCHAR_BUFSIZE=128

# 系统时钟
CONFIG_SYS_CLOCK_TICKS_PER_SEC=1000
```

## src/main.c
```c
#include <zephyr/kernel.h>
#include <zephyr/posix/sys/socket.h>
#include <zephyr/posix/unistd.h>
#include <zephyr/console/console.h>
#include <stdio.h>
#include <string.h>
#include <errno.h>

#define PORT 6666
#define BACKLOG 5
#define BUF_SIZE 1024

static int start_server(void)
{
	int serv;
	struct sockaddr_in addr;

	serv = socket(AF_INET, SOCK_STREAM, IPPROTO_TCP);
	if (serv < 0) {
		printk("socket() failed: %d\n", errno);
		return -1;
	}

	addr.sin_family = AF_INET;
	addr.sin_addr.s_addr = htonl(INADDR_ANY);
	addr.sin_port = htons(PORT);

	if (bind(serv, (struct sockaddr *)&addr, sizeof(addr)) < 0) {
		printk("bind() failed: %d\n", errno);
		close(serv);
		return -1;
	}

	if (listen(serv, BACKLOG) < 0) {
		printk("listen() failed: %d\n", errno);
		close(serv);
		return -1;
	}

	printk("TCP server on 0.0.0.0:%d\n", PORT);
	return serv;
}

static void handle_client(int client)
{
	char buf[BUF_SIZE];
	int idx = 0;
	int ret;

	printk("Client connected\n");

	while (1) {
		int c = console_getchar();

		if (c >= 0) {
			if (c == '\r' || c == '\n') {
				console_putchar('\r');
				console_putchar('\n');
				if (idx > 0) {
					buf[idx] = '\n';
					send(client, buf, idx + 1, 0);
					idx = 0;
				}
			} else if (c == '\b' || c == 0x7f) {
				if (idx > 0) {
					console_putchar('\b');
					console_putchar(' ');
					console_putchar('\b');
					idx--;
				}
			} else if (idx < (int)sizeof(buf) - 1) {
				console_putchar(c);
				buf[idx++] = (char)c;
			}
		}

		ret = recv(client, buf, sizeof(buf) - 1, MSG_DONTWAIT);
		if (ret > 0) {
			buf[ret] = '\0';
			printk("\nC: %s", buf);
		} else if (ret == 0 || (ret < 0 && errno != EAGAIN)) {
			if (ret < 0) {
				printk("\nrecv error: %d\n", errno);
			}
			break;
		}
	}

	printk("\nClient disconnected\n");
}

int main(void)
{
	int serv, client;
	struct sockaddr_in addr;
	socklen_t addr_len;

	console_init();
	console_set_rx_timeout(K_MSEC(200));

	serv = start_server();
	if (serv < 0) {
		return 0;
	}

	while (1) {
		addr_len = sizeof(addr);
		client = accept(serv, (struct sockaddr *)&addr, &addr_len);
		if (client < 0) {
			printk("accept() failed: %d\n", errno);
			continue;
		}

		handle_client(client);
		close(client);
		printk("Waiting for connection...\n");
	}

	close(serv);
	return 0;
}
```
