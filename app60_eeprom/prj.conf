## CMakeLists.txt
```
cmake_minimum_required(VERSION 3.20.0)

# Allow building custom out-of-tree boards stored in ../boards.
list(APPEND BOARD_ROOT ${CMAKE_CURRENT_SOURCE_DIR}/..)

find_package(Zephyr REQUIRED HINTS $ENV{ZEPHYR_BASE})
project(app60_eeprom)

target_sources(app PRIVATE src/main.c)
```

## prj.conf
```kconfig
CONFIG_GPIO=y
CONFIG_LOG=y
CONFIG_LOG_DEFAULT_LEVEL=3
CONFIG_UART_CONSOLE=y

# 系统tick配置
CONFIG_SYS_CLOCK_TICKS_PER_SEC=1000

CONFIG_EEPROM=y
CONFIG_EEPROM_SIMULATOR=y
```

## src/main.c
```c
#include <zephyr/kernel.h>
#include <zephyr/device.h>
#include <zephyr/drivers/eeprom.h>
#include <string.h>

#define OFF 0

int main(void)
{
    const struct device *eeprom;

    uint8_t w[16] = {
        1,2,3,4,5,6,7,8,
        9,10,11,12,13,14,15,16
    };

    uint8_t r[16];

    eeprom = DEVICE_DT_GET(DT_NODELABEL(eeprom0));

    if (!device_is_ready(eeprom)) {
        printk("EEPROM not ready\n");
        return 0;
    }

    printk("EEPROM OK: %s\n", eeprom->name);

    eeprom_write(eeprom, OFF, w, sizeof(w));
    eeprom_read(eeprom, OFF, r, sizeof(r));

    printk("DATA:\n");
    for (int i = 0; i < sizeof(r); i++) {
        printk("%02X ", r[i]);
    }
    printk("\n");

    return 0;
}
```
