## CMakeLists.txt
```
cmake_minimum_required(VERSION 3.20.0)

# Allow building custom out-of-tree boards stored in ../boards.
list(APPEND BOARD_ROOT ${CMAKE_CURRENT_SOURCE_DIR}/..)

find_package(Zephyr REQUIRED HINTS $ENV{ZEPHYR_BASE})
project(app50_spiflash)

target_sources(app PRIVATE src/main.c)
```

## prj.conf
```kconfig
CONFIG_GPIO=y
CONFIG_LOG=y
CONFIG_LOG_MODE_IMMEDIATE=y
CONFIG_LOG_DEFAULT_LEVEL=3
CONFIG_UART_CONSOLE=y

# 系统tick配置
CONFIG_SYS_CLOCK_TICKS_PER_SEC=1000

# QSPI Flash support
CONFIG_FLASH=y
CONFIG_FLASH_STM32_QSPI=y
```

## src/main.c
```c
#include <zephyr/kernel.h>
#include <zephyr/device.h>
#include <zephyr/drivers/flash.h>

#define TEST_OFFSET 0x10000

int main(void)
{
    const struct device *flash_dev;

    uint8_t write_buf[16] = {
        0x11, 0x22, 0x33, 0x44,
        0x55, 0x66, 0x77, 0x88,
        0x99, 0xaa, 0xbb, 0xcc,
        0xdd, 0xee, 0xff, 0x5a
    };

    uint8_t read_buf[16];

    flash_dev = DEVICE_DT_GET(DT_CHOSEN(zephyr_flash_controller));

    if (!device_is_ready(flash_dev)) {
        printk("Flash device not ready\n");
        return 0;
    }

    printk("Flash device: %s\n", flash_dev->name);

    printk("Erase...\n");

    int ret = flash_erase(
        flash_dev,
        TEST_OFFSET,
        4096);

    if (ret) {
        printk("erase failed %d\n", ret);
        return 0;
    }

    printk("Write...\n");

    ret = flash_write(
        flash_dev,
        TEST_OFFSET,
        write_buf,
        sizeof(write_buf));

    if (ret) {
        printk("write failed %d\n", ret);
        return 0;
    }

    printk("Read...\n");

    ret = flash_read(
        flash_dev,
        TEST_OFFSET,
        read_buf,
        sizeof(read_buf));

    if (ret) {
        printk("read failed %d\n", ret);
        return 0;
    }

    printk("Data:\n");

    for (int i = 0; i < sizeof(read_buf); i++) {
        printk("%02X ", read_buf[i]);
    }

    printk("\n");

    return 0;
}
```
